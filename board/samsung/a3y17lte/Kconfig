## board/samsung/a3y17lte/Kconfig
```kconfig
if TARGET_A3Y17LTE

config SYS_BOARD
	default "a3y17lte"
	help
	  a3y17lte is a production board for SM-A520F phone on Exynos7880 SoC.

config SYS_VENDOR
	default "samsung"

config SYS_CONFIG_NAME
	default "a3y17lte"

config EXYNOS7870
    bool "Exynos 7870 SOC support"
    default y

config MUIC_MANUAL_SWITCH
    bool "Enable manual control over muic mux usb D+ D- pins"
    select USE_PREBOOT
    select CMD_GPIO
    select CMD_I2C
    select DM_I2C_GPIO
    select HUSH_PARSER
    default n
    help
      Allows to configure muic to multiplex uart to usb data lines manually. Tx is D- Rx is D+.
      Caution! Do NOT connect usb host, while uart multiplexed, this will damage your device!

      Say no, if unsure.

endif
```

## board/samsung/a5y17lte/Kconfig
```kconfig
if TARGET_A5Y17LTE

config SYS_BOARD
	default "a5y17lte"
	help
	  a5y17lte is a production board for SM-A520F phone on Exynos7880 SoC.

config SYS_VENDOR
	default "samsung"

config SYS_CONFIG_NAME
	default "a5y17lte"

config EXYNOS7880
    bool "Exynos 7880 SOC support"
    default y

config MUIC_MANUAL_SWITCH
    bool "Enable manual control over muic mux usb D+ D- pins"
    select USE_PREBOOT
    select CMD_GPIO
    select CMD_I2C
    select DM_I2C_GPIO
    select HUSH_PARSER
    default n
    help
      Allows to configure muic to multiplex uart to usb data lines manually. Tx is D- Rx is D+.
      Caution! Do NOT connect usb host, while uart multiplexed, this will damage your device!

      Say no, if unsure.

endif
```

## board/samsung/starqltechn/Kconfig
```kconfig
if TARGET_STARQLTECHN

config SYS_BOARD
	default "starqltechn"
	help
	  starqltechn is a production board for SM-A520F phone on Exynos7880 SoC.

config SYS_VENDOR
	default "samsung"

config SYS_CONFIG_NAME
	default "starqltechn"

config SDM845
    bool "Snapdragon 845 SOC support"
    default "y"

endif
```

## configs/a3y17lte_defconfig
```kconfig
CONFIG_ARM=y
CONFIG_ARCH_EXYNOS=y
CONFIG_ARCH_EXYNOS7=y
CONFIG_S5P=y
CONFIG_TARGET_A3Y17LTE=y
CONFIG_DEFAULT_DEVICE_TREE="exynos7870-a3y17lte"
CONFIG_SYS_TEXT_BASE=0x40080000
CONFIG_BOARD_EARLY_INIT_F=n
CONFIG_SKIP_LOWLEVEL_INIT=y
CONFIG_CMD_GPIO=y
CONFIG_DISPLAY_CPUINFO=n
CONFIG_CMD_I2C=y
CONFIG_STANDALONE_LOAD_ADDR=0x10008000
CONFIG_SYS_MALLOC_F_LEN=0x8000
CONFIG_DM_I2C_GPIO=y
CONFIG_BAUDRATE=115200
```

## configs/a5y17lte_defconfig
```kconfig
CONFIG_ARM=y
CONFIG_ARCH_EXYNOS=y
CONFIG_ARCH_EXYNOS7=y
CONFIG_S5P=y
CONFIG_TARGET_A5Y17LTE=y
CONFIG_DEFAULT_DEVICE_TREE="exynos7880-a5y17lte"
CONFIG_SYS_TEXT_BASE=0x40001000
CONFIG_BOARD_EARLY_INIT_F=n
CONFIG_SKIP_LOWLEVEL_INIT=y
CONFIG_CMD_GPIO=y
CONFIG_DISPLAY_CPUINFO=n
CONFIG_CMD_I2C=y
CONFIG_STANDALONE_LOAD_ADDR=0x10008000
CONFIG_SYS_MALLOC_F_LEN=0x8000
CONFIG_DM_I2C_GPIO=y
CONFIG_BAUDRATE=921600
```

## configs/starqltechn_defconfig
```kconfig
CONFIG_TARGET_STARQLTECHN=y
CONFIG_ARM=y
CONFIG_ARM_SMCCC=y
CONFIG_ARCH_SNAPDRAGON=y
CONFIG_IDENT_STRING="\nSamsung S9 SM-G9600"
CONFIG_DEFAULT_DEVICE_TREE="starqltechn"
CONFIG_SYS_TEXT_BASE=0x000000016cb00000
# CONFIG_LINUX_KERNEL_IMAGE_HEADER=y
CONFIG_POSITION_INDEPENDENT=y
CONFIG_BOARD_EARLY_INIT_F=n
CONFIG_SKIP_LOWLEVEL_INIT=y
CONFIG_DISPLAY_CPUINFO=n
CONFIG_STANDALONE_LOAD_ADDR=0x000000016cb00000
CONFIG_SYS_MALLOC_F_LEN=0x8000
CONFIG_HUSH_PARSER=y
CONFIG_OF_CONTROL=y
CONFIG_MSM_GPIO=y
CONFIG_CLK=y
CONFIG_DM_I2C=y
CONFIG_DM_I2C_GPIO=y
CONFIG_CMD_I2C=y
CONFIG_CMD_GPIO=y
CONFIG_DEBUG_UART_BASE=0xa84000
CONFIG_MSM_GENI_SERIAL=y
CONFIG_DEBUG_UART=y
CONFIG_DEBUG_UART_MSM=y
CONFIG_DEBUG_UART_ANNOUNCE=y
CONFIG_DEBUG_UART_CLOCK=115200
```
